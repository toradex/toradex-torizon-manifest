## conf/bblayers.conf
```bitbake
# LAYER_CONF_VERSION is increased each time build/conf/bblayers.conf
# changes incompatibly
LCONF_VERSION = "6"
OEROOT := "${@os.path.abspath(os.path.dirname(d.getVar('FILE', True)))}/../.."

BBPATH = "${TOPDIR}"

BBFILES = ""

# These layers hold recipe metadata not found in OE-core, but lack any machine or distro content
BASELAYERS ?= " \
  ${OEROOT}/layers/meta-openembedded/meta-oe \
  ${OEROOT}/layers/meta-openembedded/meta-gnome \
  ${OEROOT}/layers/meta-openembedded/meta-xfce \
  ${OEROOT}/layers/meta-openembedded/meta-initramfs \
  ${OEROOT}/layers/meta-openembedded/meta-multimedia \
  ${OEROOT}/layers/meta-openembedded/meta-networking \
  ${OEROOT}/layers/meta-openembedded/meta-webserver \
  ${OEROOT}/layers/meta-openembedded/meta-ruby \
  ${OEROOT}/layers/meta-openembedded/meta-filesystems \
  ${OEROOT}/layers/meta-openembedded/meta-perl \
  ${OEROOT}/layers/meta-openembedded/meta-python \
  ${OEROOT}/layers/meta-browser \
  ${OEROOT}/layers/meta-qt5 \
"

# These layers hold machine specific content, aka Board Support Packages
BSPLAYERS ?= " \
  ${OEROOT}/layers/meta-qcom \
  ${OEROOT}/layers/meta-96boards \
"

# Add your overlay location to EXTRALAYERS
# Make sure to have a conf/layers.conf in there
EXTRALAYERS ?= " \
  ${OEROOT}/layers/meta-linaro/meta-linaro \
  ${OEROOT}/layers/meta-linaro/meta-linaro-toolchain \
  ${OEROOT}/layers/meta-linaro/meta-aarch64 \
"

BBLAYERS = " \
  ${OEROOT}/layers/meta-rpb \
  ${BASELAYERS} \
  ${BSPLAYERS} \
  ${EXTRALAYERS} \
  ${OEROOT}/layers/openembedded-core/meta \
"
```

## conf/local.conf
```bitbake
# CONF_VERSION is increased each time build/conf/ changes incompatibly
CONF_VERSION = "1"

# Which files do we want to parse:
BBMASK = ""

# Don't generate the mirror tarball for SCM repos, the snapshot is enough
BB_GENERATE_MIRROR_TARBALLS = "0"

# Disable build time patch resolution. This would lauch a devshell
# and wait for manual intervention. We disable it.
PATCHRESOLVE = "noop"

#
# Parallelism Options
#
# These two options control how much parallelism BitBake should use. The first
# option determines how many tasks bitbake should run in parallel:
# Default to setting automatically based on cpu count
BB_NUMBER_THREADS ?= "${@oe.utils.cpu_count()}"
#
# The second option controls how many processes make should run in parallel when
# running compile tasks:
# Default to setting automatically based on cpu count
PARALLEL_MAKE ?= "-j ${@oe.utils.cpu_count()}"

#
# Shared-state files from other locations
#
# Shared state files are prebuilt cache data objects which can
# used to accelerate build time. This variable can be used to configure the system
# to search other mirror locations for these objects before it builds the data itself.
#
# This can be a filesystem directory, or a remote url such as http or ftp. These
# would contain the sstate-cache results from previous builds (possibly from other
# machines). This variable works like fetcher MIRRORS/PREMIRRORS and points to the
# cache locations to check for the shared objects.
SSTATE_MIRRORS ?= "\
file://.* https://lmp-mirror.foundries.io/sstate-cache/PATH \n \
"

# enable PR service on build machine itself
# its good for a case when this is the only builder
# generating the feeds
#PRSERV_HOST = "localhost:0"

# OSF LMP specific configuration

# Beaglebone
IMAGE_FSTYPES_append_beaglebone = " wic.gz"
IMAGE_FSTYPES_remove_beaglebone = " wic"

# Dragonboard (DB410/DB820)
QCOM_BOOTIMG_ROOTFS_dragonboard-820c = "sda9"

# HiKey
CMDLINE_remove_hikey = "quiet"

# Raspberry Pi
VC4DTBO_raspberrypi3-64 = "vc4-kms-v3d"
RPI_USE_U_BOOT = "1"
IMAGE_FSTYPES_append_rpi = " ext4.gz wic.gz wic.bmap"
WKS_FILE_rpi = "raspberrypi.wks"
IMAGE_FSTYPES_remove_rpi += " ext3 rpi-sdimg"

# Intel
IMAGE_FSTYPES_append_intel-corei7-64 = " ext4.gz wic.gz"
IMAGE_FSTYPES_remove_intel-corei7-64 = " ext4 wic"

# Cross machines / BSPs
## Drop IMX BSP that is not needed
MACHINE_EXTRA_RRECOMMENDS_remove = "imx-alsa-plugins"
```
